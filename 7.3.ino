#include <Morse.h>
#include <stdio.h>
Morse morse(13);


char MORSE[][4] = {
  {'.', '-', '*', '*'}, //A
  {'-', '.', '.', '.'}, //B
  {'-', '.', '-', '.'}, //C
  {'-', '.', '.', '*'}, //D
  {'.', '*', '*', '*'}, //E
  {'.', '.', '-', '.'}, //F
  {'-', '-', '.', '*'}, //G
  {'.', '.', '.', '.'}, //H
  {'.', '.', '*', '*'}, //I
  {'.', '-', '-', '-'}, //J
  {'-', '.', '-', '*'}, //K
  {'.', '-', '.', '.'}, //L
  {'-', '-', '*', '*'}, //M
  {'-', '.', '*', '*'}, //N
  {'-', '-', '-', '*'}, //O
  {'.', '-', '-', '.'}, //P
  {'-', '-', '.', '-'}, //Q
  {'.', '-', '.', '*'}, //R
  {'.', '.', '.', '*'}, //S
  {'-', '*', '*', '*'}, //T
  {'.', '.', '-', '*'}, //U
  {'.', '.', '.', '-'}, //V
  {'.', '-', '-', '*'}, //W
  {'-', '.', '.', '-'}, //X
  {'-', '.', '-', '-'}, //Y
  {'-', '-', '.', '.'}  //Z
};

void setup()
{
  Serial.begin(9600);
}

void loop()
{
  String zfc = "";  
  String zy = "";  
  int i, j , t = 0;
  int a = 0;  
  while (Serial.available() > 0)
  {
    t = 1;  //判断是否有数据传入
    zfc += char(Serial.read());  //将传入的数据储存在字符串中
    delay(3);  //延迟保证传入正常
    a++;
  }

  if (t)
  {
    //查询Morse电码表并进行转换
    for (i = 0; i < a; i++)
    {
      for (j = 0; j < 4; j++)
      {
        //判断是否为小写字母，如果是则转义
        if (zfc[i] >= 97 && zfc[i] <= 122)
        {
          zy += char(MORSE[int(zfc[i] - 97)][j]);
        }
      }
      //每段Morse之后补空格
      zy += ' ';
    }
    Serial.println(zy);  //串口传入
    for (i = 0; zy[i]!='\0' ; i++)//从头到尾读取莫尔斯电码
    {
      if (zy[i] == '.')morse.dot();
      else if (zy[i] == '-')morse.dash();
      else if (zy[i] == ' ')morse.w_space();
      if (zy[i] != ' ' && zfc[i] != '*')morse.c_space();
    }
    Serial.println("发送完毕");
    delay(3);
  }
}
